## dunfell_yocto_20220219/poky-dunfell/build/conf/bblayers.conf
```bitbake
# POKY_BBLAYERS_CONF_VERSION is increased each time build/conf/bblayers.conf
# changes incompatibly
POKY_BBLAYERS_CONF_VERSION = "2"

BBPATH = "${TOPDIR}"
BBFILES ?= ""

BBLAYERS ?= " \
  /home/mgkang/ssd_work/rpi_works/dunfell_yocto_20220219/poky-dunfell/meta \
  /home/mgkang/ssd_work/rpi_works/dunfell_yocto_20220219/poky-dunfell/meta-poky \
  /home/mgkang/ssd_work/rpi_works/dunfell_yocto_20220219/poky-dunfell/meta-yocto-bsp \
  /home/mgkang/ssd_work/rpi_works/dunfell_yocto_20220219/poky-dunfell/meta-openembedded/meta-oe \
  /home/mgkang/ssd_work/rpi_works/dunfell_yocto_20220219/poky-dunfell/meta-openembedded/meta-multimedia \
  /home/mgkang/ssd_work/rpi_works/dunfell_yocto_20220219/poky-dunfell/meta-openembedded/meta-networking \
  /home/mgkang/ssd_work/rpi_works/dunfell_yocto_20220219/poky-dunfell/meta-openembedded/meta-perl \
  /home/mgkang/ssd_work/rpi_works/dunfell_yocto_20220219/poky-dunfell/meta-openembedded/meta-python \
  /home/mgkang/ssd_work/rpi_works/dunfell_yocto_20220219/poky-dunfell/meta-qt5 \
  /home/mgkang/ssd_work/rpi_works/dunfell_yocto_20220219/poky-dunfell/meta-raspberrypi \
  /home/mgkang/ssd_work/rpi_works/dunfell_yocto_20220219/poky-dunfell/meta-mgkang \
  "
```

## dunfell_yocto_20220219/poky-dunfell/meta-mgkang/conf/layer.conf
```bitbake
# We have a conf and classes directory, add to BBPATH
BBPATH .= ":${LAYERDIR}"

# We have recipes-* directories, add to BBFILES
BBFILES += "${LAYERDIR}/recipes-*/*/*.bb \
            ${LAYERDIR}/recipes-*/*/*.bbappend"

BBFILE_COLLECTIONS += "meta-mgkang"
BBFILE_PATTERN_meta-mgkang = "^${LAYERDIR}/"
BBFILE_PRIORITY_meta-mgkang = "6"

LAYERDEPENDS_meta-mgkang = "core"
LAYERSERIES_COMPAT_meta-mgkang = "dunfell"
```
